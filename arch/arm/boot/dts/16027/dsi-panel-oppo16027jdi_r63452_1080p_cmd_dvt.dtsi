/* Copyright (c) 2015-2016, The Linux Foundation. All rights reserved.
 *
 * This program is free software; you can redistribute it and/or modify
 * it under the terms of the GNU General Public License version 2 and
 * only version 2 as published by the Free Software Foundation.
 *
 * This program is distributed in the hope that it will be useful,
 * but WITHOUT ANY WARRANTY; without even the implied warranty of
 * MERCHANTABILITY or FITNESS FOR A PARTICULAR PURPOSE.  See the
 * GNU General Public License for more details.
 */

/*---------------------------------------------------------------------------
 * This file is autogenerated file using gcdb parser. Please do not edit it.
 * Update input XML file to add a new entry or update variable in this file
 * VERSION = "1.0"
 *---------------------------------------------------------------------------*/
&mdss_mdp {
        dsi_oppo16027jdi_r63452_1080p_cmd_dvt: qcom,mdss_dsi_oppo16027jdi_r63452_1080p_cmd_dvt {
                qcom,cont-splash-enabled;
                qcom,mdss-dsi-panel-name = "oppo16027jdi r63452 1080p cmd mode dsi panel evt";
                qcom,mdss-dsi-panel-manufacture = "JDI-DVT";
                qcom,mdss-dsi-panel-version = "R63452-DVT";
                qcom,mdss-dsi-panel-controller = <&mdss_dsi0>;
                qcom,mdss-dsi-panel-type = "dsi_cmd_mode";
                qcom,mdss-dsi-panel-destination = "display_1";
                qcom,mdss-dsi-panel-framerate = <60>;
                qcom,mdss-dsi-virtual-channel-id = <0>;
                qcom,mdss-dsi-stream = <0>;
                qcom,mdss-dsi-panel-width = <1080>;
                qcom,mdss-dsi-panel-height = <1920>;
                qcom,mdss-dsi-h-front-porch = <100>;
                qcom,mdss-dsi-h-back-porch = <94>;
                qcom,mdss-dsi-h-pulse-width = <2>;
                qcom,mdss-dsi-h-sync-skew = <0>;
                qcom,mdss-dsi-v-back-porch = <20>;
                qcom,mdss-dsi-v-front-porch = <8>;
                qcom,mdss-dsi-v-pulse-width = <4>;
                qcom,mdss-dsi-h-left-border = <0>;
                qcom,mdss-dsi-h-right-border = <0>;
                qcom,mdss-dsi-v-top-border = <0>;
                qcom,mdss-dsi-v-bottom-border = <0>;
                qcom,mdss-dsi-bpp = <24>;
                qcom,mdss-dsi-color-order = "rgb_swap_rgb";
                qcom,mdss-dsi-underflow-color = <0xff>;
                qcom,mdss-dsi-border-color = <0>;
                qcom,mdss-dsi-on-command = [
                    39 01 00 00 00 00 02 35 00
                    23 01 00 00 00 00 02 B0 04
                    23 01 00 00 00 00 02 D6 01
                    29 01 00 00 00 00 04 B3 04 00 02
                    29 01 00 00 00 00 03 B4 00 03
                    29 01 00 00 00 00 04 B6 3A DB 07
                    23 01 00 00 00 00 02 C0 00
                    29 01 00 00 00 00 30 C1 84 60 00 A0 84 81 08 00 06
                                         00 00 96 4A AE 31 D6 5C 52 0B
                                         00 00 0C 00 04 0C 01 00 10 10
                                         10 10 10 42 20 02 01 00 01 81
                                         10 14 8A 00 00 00 00 00
                    29 01 00 00 00 00 09 C2 01 07 80 04 00 04 F0 00
                    29 01 00 00 00 00 09 C4 70 00 00 04 16 16 12 00
                    29 01 00 00 00 00 16 C6 53 2E 2E 05 45 00 00 00 00
                                         00 00 42 0F 00 00 00 00 04 12
                                         04 8C
                    29 01 00 00 00 00 11 CB BE E1 FF 61 0D 00 00 00 00
                                         00 00 00 00 00 00 C3
                    23 01 00 00 00 00 02 CC 0D
                    29 01 00 00 00 00 05 D0 44 15 93 00
                    29 01 00 00 00 00 0A D1 1B 0C 02 04 84 33 E3 33 2B
                    29 01 00 00 00 00 1F D3 DD 53 53 22 3A 14 33 33 37
                                         55 3B BB BB BB BF 01 FD 00 00
                                         00 00 FB BF 4D 85 7D 01 49 49
                                         00
                    29 01 00 00 00 00 0D D5 66 00 00 00 01 2C 01 2C 01
                                         2C 01 2C
                    29 01 00 00 00 00 12 D9 78 96 92 A0 A9 98 D7 06 00
                                         00 10 00 00 00 01 14 40
                    29 01 00 00 00 00 30 EC 64 D8 EC 3B 52 00 0B 0B 13
                                         15 68 0B B5 28 28 00 25 04 21
                                         00 00 3F 00 00 00 00 00 97 00
                                         00 00 00 00 05 24 05 11 21 00
                                         00 00 00 00 00 00 00 00
                    29 01 00 00 00 00 29 ED 2B 2C 2B 1B 00 6A 99 03 19
                                         91 F2 00 00 03 16 19 3F 14 14
                                         2A 23 00 20 00 00 57 77 55 85
                                         09 45 40 00 20 00 53 00 00 09
                                         45
                    29 01 00 00 00 00 29 EE 15 58 57 05 00 6A 99 03 00
                                         01 B2 00 00 03 00 00 33 14 14
                                         00 21 00 20 00 00 57 77 55 85
                                         13 1B 40 00 20 00 53 00 00 13
                                         1B
                    29 01 00 00 00 00 29 EF 2B 2C 2B 1B 00 00 00 00 00
                                         00 00 00 00 03 16 19 0F 14 00
                                         00 20 00 00 00 00 A6 77 55 85
                                         09 45 40 00 20 00 53 00 00 09
                                         45
                    29 01 00 00 00 00 29 F0 D1 08 58 CD 00 00 00 00 00
                                         00 00 00 CE D1 00 00 03 14 00
                                         00 20 00 00 00 00 A7 77 55 85
                                         01 3D 40 00 20 00 53 00 00 13
                                         1B
                    29 01 00 00 00 00 1F C7 00 14 1D 28 38 46 50 5F 43
                                         4B 56 64 6E 76 7F 00 14 1D 28
                                         38 46 50 5F 43 4B 56 64 6E 76
                                         7F
                    29 01 00 00 00 00 32 C8 01 00 FE 04 FF FC 00 00 FF
                                         04 FC FC 00 00 00 01 F3 E3 00
                                         00 FE 04 FF FC 00 FF 04 FC FC
                                         00 00 01 F3 E3 00 FE 04 FF FC
                                         00 FF 04 FC FC 00 00 01 F3 E3
                    29 01 00 00 00 00 14 C9 00 00 00 00 00 FC 00 00 00
                                         00 00 FC 00 00 00 00 00 FC 00
                    29 01 00 00 00 00 23 D7 0C FF E1 BF E4 8C 11 7F F0
                                         A0 1F 3F 10 99 C0 F8 80 70 0C
                                         1C 87 88 01 F8 7B 43 3E 20 78
                                         22 47 00 00 8F
                    29 01 00 00 00 00 08 B8 57 3D 19 1E 0A 50 50
                    29 01 00 00 00 00 08 B9 6F 3D 28 3C 14 C8 C8
                    29 01 00 00 00 00 08 BA B5 33 41 64 23 A0 A0
                    29 01 00 00 00 00 1A CE 55 40 49 53 59 5E 63 68 6E
                                         74 7E 8A 98 A8 BB D0 FF 04 00
                                         04 04 42 00 69 5A
                    29 01 00 00 00 00 03 BB 14 14
                    29 01 00 00 00 00 03 BC 37 32
                    29 01 00 00 00 00 03 BD 64 32
                    29 01 00 00 00 00 2C CA 1C FC FC FC 00 00 00 00 00
                                         00 00 00 00 00 00 00 00 00 00
                                         00 00 00 00 00 00 00 00 00 00
                                         00 00 00 00 00 00 00 00 00 00
                                         00 00 00 00
                    29 01 00 00 00 00 05 DD 30 06 23 65
                    23 01 00 00 00 00 02 B0 03
                    39 01 00 00 00 00 02 36 00
                    39 01 00 00 00 00 02 3A 77
                    39 01 00 00 00 00 05 2A 00 00 04 37
                    39 01 00 00 00 00 05 2B 00 00 07 7F
                    39 01 00 00 00 00 03 44 00 00
                    39 01 00 00 00 00 02 51 FF
                    39 01 00 00 00 00 02 53 24
                    39 01 00 00 00 00 02 55 02
                    39 01 00 00 00 00 02 5E 00
                    39 01 00 00 00 00 08 B9 8F 4D 13 20 02 30 30
                    39 01 00 00 00 00 1A CE 11 40 49 53 59 5E 63 68 6E
                                         74 7E 8A 98 A8 BB D0 FF 04 00
                                         04 04 42 00 69 5A
                    39 01 00 00 78 00 02 11 00
                    39 01 00 00 14 00 02 29 00];
                qcom,mdss-dsi-off-command = [05 01 00 00 14 00 02 28 00
                    05 01 00 00 78 00 02 10 00];
                qcom,mdss-dsi-on-command-state = "dsi_lp_mode";
                qcom,mdss-dsi-off-command-state = "dsi_hs_mode";
                qcom,mdss-dsi-h-sync-pulse = <1>;
                qcom,mdss-dsi-traffic-mode = "burst_mode";
                qcom,mdss-dsi-lane-map = "lane_map_0123";
                qcom,mdss-dsi-bllp-eof-power-mode;
                qcom,mdss-dsi-bllp-power-mode;
                qcom,mdss-dsi-lane-0-state;
                qcom,mdss-dsi-lane-1-state;
                qcom,mdss-dsi-lane-2-state;
                qcom,mdss-dsi-lane-3-state;
                qcom,mdss-dsi-panel-timings = [E6 38 26 00 68 6C 2A 3C 2C 03 04 00];
                qcom,mdss-dsi-te-pin-select = <1>;
                qcom,mdss-dsi-te-v-sync-rd-ptr-irq-line = <0x2c>;
                qcom,mdss-dsi-te-v-sync-continue-lines = <0x3c>;
                qcom,mdss-dsi-te-dcs-command = <1>;
                qcom,mdss-dsi-te-check-enable;
                qcom,mdss-dsi-te-using-te-pin;
                qcom,mdss-dsi-t-clk-post = <0x02>;
                qcom,mdss-dsi-t-clk-pre = <0x2B>;
                qcom,mdss-dsi-bl-min-level = <1>;
                qcom,mdss-dsi-bl-max-level = <2047>;
                qcom,mdss-brightness-max-level = <2047>;
                qcom,mdss-dsi-dma-trigger = "trigger_sw";
                qcom,mdss-dsi-mdp-trigger = "trigger_sw";
                qcom,mdss-dsi-bl-pmic-control-type = "bl_ctrl_wled";
                qcom,mdss-dsi-lp11-init;
                qcom,mdss-dsi-init-delay-us = <5000>;
                qcom,mdss-dsi-reset-sequence = <1 15>, <0 2>, <1 15>;
                qcom,mdss-dsi-rx-eot-ignore;
                qcom,mdss-dsi-tx-eot-append;
                qcom,esd-check-enabled;
                qcom,mdss-dsi-panel-status-read-length = <1>;
                qcom,mdss-dsi-panel-status-check-mode="reg_read";
                qcom,mdss-dsi-panel-status-command = [06 01 00 01 05 00 02 0A 08];
                qcom,mdss-dsi-panel-status-command-state = "dsi_lp_mode";
                qcom,mdss-dsi-panel-status-value = <0x38>;
                qcom,mdss-pan-physical-width-dimension = <68>;
                qcom,mdss-pan-physical-height-dimension = <122>;
                qcom,mdss-mdp-transfer-time-us = <12000>;
                qcom,mdss-dsi-cabc-off-command = [15 01 00 00 00 00 02 53 2C
                    15 01 00 00 00 00 02 55 00
                    05 01 00 00 10 00 02 29 00];
                qcom,mdss-dsi-cabc-ui-command = [15 01 00 00 00 00 02 53 2C
                    15 01 00 00 00 00 02 55 01
                    05 01 00 00 10 00 02 29 00];
                qcom,mdss-dsi-cabc-still-image-command = [15 01 00 00 00 00 02 53 2C
                    15 01 00 00 00 00 02 55 02
                    05 01 00 00 10 00 02 29 00];
                qcom,mdss-dsi-cabc-video-command = [15 01 00 00 00 00 02 53 2C
                    15 01 00 00 00 00 02 55 02
                    05 01 00 00 10 00 02 29 00];
        };
};
