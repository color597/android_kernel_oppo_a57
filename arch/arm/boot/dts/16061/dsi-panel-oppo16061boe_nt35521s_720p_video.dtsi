/* Copyright (c) 2013-2015, The Linux Foundation. All rights reserved.
 *
 * This program is free software; you can redistribute it and/or modify
 * it under the terms of the GNU General Public License version 2 and
 * only version 2 as published by the Free Software Foundation.
 *
 * This program is distributed in the hope that it will be useful,
 * but WITHOUT ANY WARRANTY; without even the implied warranty of
 * MERCHANTABILITY or FITNESS FOR A PARTICULAR PURPOSE.  See the
 * GNU General Public License for more details.
 */

&mdss_mdp {
	dsi_boe_oppo16061_nt35521s_720p_video: qcom,mdss_dsi_oppo16061boe_nt35521s_720p_video{
	    qcom,cont-splash-enabled;
		qcom,mdss-dsi-panel-name = "oppo16061boe nt35521s 720p video mode dsi panel";
		qcom,mdss-dsi-panel-manufacture = "BOE";
		qcom,mdss-dsi-panel-version = "NT35521S-VIDEO";
		qcom,mdss-dsi-panel-type = "dsi_video_mode";
		qcom,mdss-dsi-panel-framerate = <60>;
		qcom,mdss-dsi-virtual-channel-id = <0>;
		qcom,mdss-dsi-stream = <0>;
		qcom,mdss-dsi-panel-width = <720>;
		qcom,mdss-dsi-panel-height = <1280>;
		qcom,mdss-dsi-h-front-porch = <148>;
		qcom,mdss-dsi-h-back-porch = <138>;
		qcom,mdss-dsi-h-pulse-width = <12>;
		qcom,mdss-dsi-h-sync-skew = <0>;
		qcom,mdss-dsi-v-back-porch = <15>;
		qcom,mdss-dsi-v-front-porch = <14>;
		qcom,mdss-dsi-v-pulse-width = <1>;
		qcom,mdss-dsi-h-left-border = <0>;
		qcom,mdss-dsi-h-right-border = <0>;
		qcom,mdss-dsi-v-top-border = <0>;
		qcom,mdss-dsi-v-bottom-border = <0>;
		qcom,mdss-dsi-bpp = <24>;
		qcom,mdss-dsi-underflow-color = <0xff>;
		qcom,mdss-dsi-border-color = <0>;
		qcom,mdss-dsi-on-command = [39 01 00 00 00 00 05 FF AA 55 25 01
        39 01 00 00 00 00 02 FC 08
        39 01 00 00 00 00 02 FC 00
        39 01 00 00 00 00 05 FF AA 55 25 00
        39 01 00 00 00 00 06 F0 55 AA 52 08 00
        39 01 00 00 00 00 03 B1 68 27
        15 01 00 00 00 00 02 B6 0E
        39 01 00 00 00 00 05 B8 00 00 00 00
        39 01 00 00 00 00 03 BB 11 11
        39 01 00 00 00 00 03 BC 00 00
        15 01 00 00 00 00 02 C8 80
        39 01 00 00 00 00 06 F0 55 AA 52 08 01
        39 01 00 00 00 00 03 B3 19 19
        39 01 00 00 00 00 03 B4 19 19
        39 01 00 00 00 00 03 B9 25 25
        39 01 00 00 00 00 03 BA 25 25
        39 01 00 00 00 00 03 BC 4E 00
        39 01 00 00 00 00 03 BD 62 00
        39 01 00 00 00 00 06 F0 55 AA 52 08 02
        //15 01 00 00 00 00 02 EE 00
        //39 01 00 00 00 00 11 B0 00 01 00 19 00 3C 00 57 00 6D 00 91 00 AE 00 DC
        //39 01 00 00 00 00 11 B1 01 02 01 3D 01 6D 01 B8 01 F2 01 F4 02 2C 02 68
        //39 01 00 00 00 00 11 B2 02 8C 02 BF 02 E5 03 0C 03 3A 03 68 03 86 03 AD
        //39 01 00 00 00 00 05 B3 03 DD 03 FF
        //39 01 00 00 00 00 11 B4 00 59 00 65 00 78 00 89 00 98 00 B5 00 CC 00 F4
        //39 01 00 00 00 00 11 B5 01 16 01 4C 01 78 01 BF 01 F7 01 F9 02 30 02 6A
        //39 01 00 00 00 00 11 B6 02 8F 02 C2 02 E7 03 10 03 3C 03 67 03 84 03 A9
        //39 01 00 00 00 00 05 B7 03 D1 03 FF
        //39 01 00 00 00 00 11 B8 00 CD 00 D2 00 DB 00 E4 00 EC 00 FD 01 0C 01 28
        //39 01 00 00 00 00 11 B9 01 41 01 6C 01 91 01 CF 02 03 02 05 02 39 02 72
        //39 01 00 00 00 00 11 BA 02 97 02 CE 02 F6 03 3B 03 5D 03 77 03 82 03 A8
        //39 01 00 00 00 00 05 BB 03 C6 03 FF
        //39 01 00 00 00 00 11 BC 00 01 00 19 00 3C 00 57 00 6D 00 91 00 AE 00 DC
        //39 01 00 00 00 00 11 BD 01 02 01 3D 01 6D 01 B8 01 F2 01 F4 02 2C 02 68
        //39 01 00 00 00 00 11 BE 02 8C 02 BF 02 E5 03 0C 03 3A 03 68 03 86 03 AD
        //39 01 00 00 00 00 05 BF 03 DD 03 FF
        //39 01 00 00 00 00 11 C0 00 59 00 65 00 78 00 89 00 98 00 B5 00 CC 00 F4
        //39 01 00 00 00 00 11 C1 01 16 01 4C 01 78 01 BF 01 F7 01 F9 02 30 02 6A
        //39 01 00 00 00 00 11 C2 02 8F 02 C2 02 E7 03 10 03 3C 03 67 03 84 03 A9
        //39 01 00 00 00 00 05 C3 03 D1 03 FF
        //39 01 00 00 00 00 11 C4 00 CD 00 D2 00 DB 00 E4 00 EC 00 FD 01 0C 01 28
        //39 01 00 00 00 00 11 C5 01 41 01 6C 01 91 01 CF 02 03 02 05 02 39 02 72
        //39 01 00 00 00 00 11 C6 02 97 02 CE 02 F6 03 3B 03 5D 03 77 03 82 03 A8
        //39 01 00 00 00 00 05 C7 03 C6 03 FF
        39 01 00 00 00 00 06 F0 55 AA 52 08 06
        39 01 00 00 00 00 03 B0 2E 2E
        39 01 00 00 00 00 03 B1 02 00
        39 01 00 00 00 00 03 B2 16 18
        39 01 00 00 00 00 03 B3 10 12
        39 01 00 00 00 00 03 B4 34 34
        39 01 00 00 00 00 03 B5 34 34
        39 01 00 00 00 00 03 B6 34 34
        39 01 00 00 00 00 03 B7 34 2E
        39 01 00 00 00 00 03 B8 2E 2E
        39 01 00 00 00 00 03 B9 2D 2D
        39 01 00 00 00 00 03 BA 2D 2D
        39 01 00 00 00 00 03 BB 2E 2E
        39 01 00 00 00 00 03 BC 2E 34
        39 01 00 00 00 00 03 BD 34 34
        39 01 00 00 00 00 03 BE 34 34
        39 01 00 00 00 00 03 BF 34 34
        39 01 00 00 00 00 03 C0 13 11
        39 01 00 00 00 00 03 C1 19 17
        39 01 00 00 00 00 03 C2 01 03
        39 01 00 00 00 00 03 C3 2E 2E
        39 01 00 00 00 00 03 E5 34 34
        39 01 00 00 00 00 03 C4 2E 2D
        39 01 00 00 00 00 03 C5 01 03
        39 01 00 00 00 00 03 C6 13 11
        39 01 00 00 00 00 03 C7 19 17
        39 01 00 00 00 00 03 C8 34 34
        39 01 00 00 00 00 03 C9 34 34
        39 01 00 00 00 00 03 CA 34 34
        39 01 00 00 00 00 03 CB 34 2E
        39 01 00 00 00 00 03 CC 2E 2E
        39 01 00 00 00 00 03 CD 2D 2E
        39 01 00 00 00 00 03 CE 2E 2D
        39 01 00 00 00 00 03 CF 2E 2E
        39 01 00 00 00 00 03 D0 2E 34
        39 01 00 00 00 00 03 D1 34 34
        39 01 00 00 00 00 03 D2 34 34
        39 01 00 00 00 00 03 D3 34 34
        39 01 00 00 00 00 03 D4 16 18
        39 01 00 00 00 00 03 D5 10 12
        39 01 00 00 00 00 03 D6 02 00
        39 01 00 00 00 00 03 D7 2D 2E
        39 01 00 00 00 00 06 D8 00 00 00 00 00
        39 01 00 00 00 00 06 D9 00 00 00 00 00
        39 01 00 00 00 00 03 E6 34 34
        39 01 00 00 00 00 06 F0 55 AA 52 08 05
        15 01 00 00 00 00 02 C0 09
        15 01 00 00 00 00 02 C1 07
        39 01 00 00 00 00 03 C8 07 20
        39 01 00 00 00 00 03 C9 03 20
        39 01 00 00 00 00 06 D1 00 04 FD 07 00
        39 01 00 00 00 00 06 D2 00 05 05 03 00
        39 01 00 00 00 00 06 F0 55 AA 52 08 03
        39 01 00 00 00 00 03 B0 00 00
        39 01 00 00 00 00 03 B1 00 00
        39 01 00 00 00 00 06 B2 05 01 00 00 00
        39 01 00 00 00 00 06 B3 05 01 00 00 00
        39 01 00 00 00 00 06 BA 53 01 00 00 00
        39 01 00 00 00 00 06 BB 53 01 00 00 00
        39 01 00 00 00 00 06 F0 55 AA 52 08 04
        15 01 00 00 00 00 02 C3 83
        15 01 00 00 00 00 02 E5 18
        39 01 00 00 00 00 05 EA 00 00 20 4C
        15 01 00 00 00 00 02 51 FF
        15 01 00 00 00 00 02 53 24
        15 01 00 00 00 00 02 55 01
        15 01 00 00 00 00 02 35 00
        39 01 00 00 00 00 06 F0 55 AA 52 08 00
        15 01 00 00 00 00 02 D6 22
        39 01 00 00 00 00 0E D5 00 00 00 00 00 00 00 00 00 00 00 00 00
        15 01 00 00 00 00 02 EC 05
        39 01 00 00 00 00 04 D9 01 01 4D
        05 01 00 00 78 00 02 11 00
        05 01 00 00 0A 00 02 29 00];
		qcom,mdss-dsi-off-command = [05 01 00 00 32 00 02 28 00
					05 01 00 00 64 00 02 10 00];
		qcom,mdss-dsi-on-command-state = "dsi_lp_mode";
		qcom,mdss-dsi-off-command-state = "dsi_hs_mode";
		qcom,mdss-dsi-h-sync-pulse = <1>;
		qcom,mdss-dsi-traffic-mode = "burst_mode";
		qcom,mdss-dsi-bllp-eof-power-mode;
		qcom,mdss-dsi-bllp-power-mode;
		qcom,mdss-dsi-hfp-power-mode;
		qcom,mdss-dsi-hbp-power-mode;
		qcom,mdss-dsi-hsa-power-mode;
		qcom,mdss-dsi-lane-0-state;
		qcom,mdss-dsi-lane-1-state;
		qcom,mdss-dsi-lane-2-state;
		qcom,mdss-dsi-lane-3-state;
		qcom,mdss-dsi-panel-timings = [8E 1E 14 00 42 46 18 20 16 03 04 00];
		qcom,mdss-dsi-t-clk-post = <0x04>;
		qcom,mdss-dsi-t-clk-pre = <0x1C>;
		qcom,mdss-dsi-bl-min-level = <2>;
		qcom,mdss-dsi-bl-max-level = <2047>;
		qcom,mdss-brightness-max-level = <2047>;
		qcom,mdss-dsi-dma-trigger = "trigger_sw";
		qcom,mdss-dsi-mdp-trigger = "none";
		qcom,mdss-dsi-bl-pmic-control-type = "bl_ctrl_dcs";
		qcom,mdss-dsi-reset-sequence = <1 5>, <0 5>, <1 5>;
		qcom,mdss-pan-physical-width-dimension = <65>;
		qcom,mdss-pan-physical-height-dimension = <115>;
		qcom,mdss-dsi-lp11-init;
		qcom,mdss-dsi-init-delay-us = <30000>;
		qcom,mdss-dsi-te-check-enable;
		qcom,mdss-dsi-te-using-te-pin;
		//qcom,ulps-enabled;
		qcom,esd-check-enabled;
		qcom,mdss-dsi-panel-status-command = [06 01 00 01 05 00 02 0A 08];
		qcom,mdss-dsi-panel-status-command-state = "dsi_lp_mode";
		qcom,mdss-dsi-panel-status-check-mode = "reg_read";
		qcom,mdss-dsi-panel-status-read-length = <1>;
		qcom,mdss-dsi-panel-status-value = <0x9C>;
		qcom,mdss-dsi-pan-enable-dynamic-fps;
		qcom,mdss-dsi-pan-fps-update = "dfps_immediate_porch_mode";
		qcom,mdss-dsi-min-refresh-rate = <50>;
		qcom,mdss-dsi-max-refresh-rate = <60>;
	};
};
