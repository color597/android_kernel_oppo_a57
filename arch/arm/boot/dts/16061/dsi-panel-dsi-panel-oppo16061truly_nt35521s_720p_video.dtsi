/* Copyright (c) 2013, The Linux Foundation. All rights reserved.
 *
 * This program is free software; you can redistribute it and/or modify
 * it under the terms of the GNU General Public License version 2 and
 * only version 2 as published by the Free Software Foundation.
 *
 * This program is distributed in the hope that it will be useful,
 * but WITHOUT ANY WARRANTY; without even the implied warranty of
 * MERCHANTABILITY or FITNESS FOR A PARTICULAR PURPOSE.  See the
 * GNU General Public License for more details.
 */

/*---------------------------------------------------------------------------
 * This file is autogenerated file using gcdb parser. Please do not edit it.
 * Update input XML file to add a new entry or update variable in this file
 * TAG:MultiMedia.Display.LCD
 * VERSION = "1.0"
 *---------------------------------------------------------------------------*/
&mdss_mdp {
	dsi_truly_oppo16061_nt35521s_720p_video: qcom,mdss_dsi_oppo16061truly_nt35521s_720p_video{
	    qcom,cont-splash-enabled;
		qcom,mdss-dsi-panel-name = "oppo16061truly nt35521s 720p video mode dsi panel";
		qcom,mdss-dsi-panel-manufacture = "TRULY";
		qcom,mdss-dsi-panel-version = "NT35521S-VIDEO-AUO-G5D";
		qcom,mdss-dsi-panel-type = "dsi_video_mode";
		qcom,mdss-dsi-panel-destination = "display_1";
		qcom,mdss-dsi-panel-framerate = <60>;
		qcom,mdss-dsi-virtual-channel-id = <0>;
		qcom,mdss-dsi-stream = <0>;
		qcom,mdss-dsi-panel-width = <720>;
		qcom,mdss-dsi-panel-height = <1280>;
		qcom,mdss-dsi-h-front-porch = <174>;
		qcom,mdss-dsi-h-back-porch = <184>;
		qcom,mdss-dsi-h-pulse-width = <12>;
		qcom,mdss-dsi-h-sync-skew = <0>;
		qcom,mdss-dsi-v-back-porch = <15>;
		qcom,mdss-dsi-v-front-porch = <14>;
		qcom,mdss-dsi-v-pulse-width = <1>;
		qcom,mdss-dsi-h-left-border = <0>;
		qcom,mdss-dsi-h-right-border = <0>;
		qcom,mdss-dsi-v-top-border = <0>;
		qcom,mdss-dsi-v-bottom-border = <0>;
		qcom,mdss-dsi-bpp = <24>;
		qcom,mdss-dsi-color-order = "rgb_swap_rgb";
		qcom,mdss-dsi-underflow-color = <0xff>;
		qcom,mdss-dsi-border-color = <0>;
		qcom,mdss-dsi-on-command = [39 01 00 00 00 00 06 F0 55 AA 52 08 00
15 01 00 00 00 00 02 D6 22
39 01 00 00 00 00 0E D5 00 00 00 00 00 00 00 00 00 00 00 00 00
15 01 00 00 00 00 02 6F 02
39 01 00 00 00 00 05 B8 00 00 00 00
39 01 00 00 00 00 03 B1 68 27
39 01 00 00 00 00 06 BD 01 A3 20 10 01
39 01 00 00 00 00 03 BB 44 44
39 01 00 00 00 00 03 BC 00 00
15 01 00 00 00 00 02 B6 01
15 01 00 00 00 00 02 C8 83
39 01 00 00 00 00 06 F0 55 AA 52 08 01
39 01 00 00 00 00 03 B0 0F 0F
39 01 00 00 00 00 03 B1 0F 0F
15 01 00 00 00 00 02 CE 66
15 01 00 00 00 00 02 C0 0C
39 01 00 00 00 00 03 B5 04 04
39 01 00 00 00 00 03 B3 28 28
39 01 00 00 00 00 03 B4 19 19
39 01 00 00 00 00 03 B9 35 35
39 01 00 00 00 00 03 BA 25 25
39 01 00 00 00 00 03 BC 68 00
39 01 00 00 00 00 03 BD 68 00
15 01 00 00 00 00 02 CA 00
39 01 00 00 00 00 06 F0 55 AA 52 08 02
15 01 00 00 00 00 02 ED 01
39 01 00 00 00 00 05 EF 11 0D 16 19
39 01 00 00 00 00 06 F0 55 AA 52 08 06
39 01 00 00 00 00 03 B0 2E 09
39 01 00 00 00 00 03 B1 0B 23
39 01 00 00 00 00 03 B2 1D 25
39 01 00 00 00 00 03 B3 1F 11
39 01 00 00 00 00 03 B4 2E 2E
39 01 00 00 00 00 03 B5 2E 17
39 01 00 00 00 00 03 B6 13 19
39 01 00 00 00 00 03 B7 2E 2E
39 01 00 00 00 00 03 B8 01 03
39 01 00 00 00 00 03 B9 2E 2E
39 01 00 00 00 00 03 BA 2E 2E
39 01 00 00 00 00 03 BB 02 00
39 01 00 00 00 00 03 BC 2E 2E
39 01 00 00 00 00 03 BD 18 12
39 01 00 00 00 00 03 BE 16 2E
39 01 00 00 00 00 03 BF 2E 2E
39 01 00 00 00 00 03 C0 10 1E
39 01 00 00 00 00 03 C1 24 1C
39 01 00 00 00 00 03 C2 22 0A
39 01 00 00 00 00 03 C3 08 2E
39 01 00 00 00 00 03 E5 2E 2E
39 01 00 00 00 00 03 C4 2E 02
39 01 00 00 00 00 03 C5 00 24
39 01 00 00 00 00 03 C6 1E 22
39 01 00 00 00 00 03 C7 1C 18
39 01 00 00 00 00 03 C8 2E 2E
39 01 00 00 00 00 03 C9 2E 12
39 01 00 00 00 00 03 CA 16 10
39 01 00 00 00 00 03 CB 2E 2E
39 01 00 00 00 00 03 CC 0A 08
39 01 00 00 00 00 03 CD 2E 2E
39 01 00 00 00 00 03 CE 2E 2E
39 01 00 00 00 00 03 CF 09 0B
39 01 00 00 00 00 03 D0 2E 2E
39 01 00 00 00 00 03 D1 11 17
39 01 00 00 00 00 03 D2 13 2E
39 01 00 00 00 00 03 D3 2E 2E
39 01 00 00 00 00 03 D4 19 1D
39 01 00 00 00 00 03 D5 23 1F
39 01 00 00 00 00 03 D6 25 01
39 01 00 00 00 00 03 D7 03 2E
39 01 00 00 00 00 03 E6 2E 2E
39 01 00 00 00 00 06 D8 00 00 00 00 00
39 01 00 00 00 00 06 D9 00 00 00 00 00
15 01 00 00 00 00 02 E7 00
39 01 00 00 00 00 06 F0 55 AA 52 08 05
39 01 00 00 00 00 03 B0 17 06
39 01 00 00 00 00 03 B1 17 06
39 01 00 00 00 00 03 B2 17 06
39 01 00 00 00 00 03 B3 17 06
39 01 00 00 00 00 03 B4 17 06
39 01 00 00 00 00 03 B5 17 06
39 01 00 00 00 00 03 B6 17 06
39 01 00 00 00 00 03 B7 17 06
15 01 00 00 00 00 02 B8 00
39 01 00 00 00 00 03 B9 00 03
39 01 00 00 00 00 03 BA 00 03
39 01 00 00 00 00 03 BB 00 00
39 01 00 00 00 00 03 BC 00 01
39 01 00 00 00 00 06 BD 0F 03 03 00 03
15 01 00 00 00 00 02 C0 07
15 01 00 00 00 00 02 C1 05
15 01 00 00 00 00 02 C4 82
15 01 00 00 00 00 02 C5 80
39 01 00 00 00 00 03 C8 03 20
39 01 00 00 00 00 03 C9 01 21
39 01 00 00 00 00 03 CA 03 20
39 01 00 00 00 00 03 CB 07 20
39 01 00 00 00 00 0c D1 03 05 00 05 00 00 00 00 00 00 00
39 01 00 00 00 00 0c D2 03 05 00 03 00 00 00 00 00 00 00
39 01 00 00 00 00 0c D3 03 05 04 05 00 00 00 00 00 00 00
39 01 00 00 00 00 0c D4 03 05 04 03 00 00 00 00 00 00 00
15 01 00 00 00 00 02 E5 06
15 01 00 00 00 00 02 E6 06
15 01 00 00 00 00 02 E7 06
15 01 00 00 00 00 02 E8 06
15 01 00 00 00 00 02 E9 0A
15 01 00 00 00 00 02 EA 06
15 01 00 00 00 00 02 EB 06
15 01 00 00 00 00 02 EC 06
15 01 00 00 00 00 02 ED 30
39 01 00 00 00 00 06 F0 55 AA 52 08 03
39 01 00 00 00 00 03 B0 00 00
39 01 00 00 00 00 03 B1 00 00
39 01 00 00 00 00 06 B2 04 00 40 01 58
39 01 00 00 00 00 06 B3 04 00 40 01 58
39 01 00 00 00 00 06 B6 04 00 46 01 68
39 01 00 00 00 00 06 B7 04 00 46 01 68
39 01 00 00 00 00 06 BA 44 00 46 01 55
39 01 00 00 00 00 06 BB 44 00 46 01 55
39 01 00 00 00 00 06 BC 53 00 15 00 48
39 01 00 00 00 00 06 BD 53 00 15 00 48
15 01 00 00 00 00 02 51 FF
15 01 00 00 00 00 02 53 24
15 01 00 00 00 00 02 55 01
05 01 00 00 78 00 02 11 00
05 01 00 00 0A 00 02 29 00];
		qcom,mdss-dsi-off-command = [05 01 00 00 32 00 02 28 00
					05 01 00 00 64 00 02 10 00];
		qcom,mdss-dsi-on-command-state = "dsi_lp_mode";
		qcom,mdss-dsi-off-command-state = "dsi_hs_mode";
		qcom,mdss-dsi-h-sync-pulse = <1>;
		qcom,mdss-dsi-traffic-mode = "burst_mode";
		qcom,mdss-dsi-lane-map = "lane_map_0123";
		qcom,mdss-dsi-bllp-eof-power-mode;
		qcom,mdss-dsi-bllp-power-mode;
		qcom,mdss-dsi-hfp-power-mode;
		qcom,mdss-dsi-hbp-power-mode;
		qcom,mdss-dsi-hsa-power-mode;
		qcom,mdss-dsi-lane-0-state;
		qcom,mdss-dsi-lane-1-state;
		qcom,mdss-dsi-lane-2-state;
		qcom,mdss-dsi-lane-3-state;
		qcom,mdss-dsi-panel-timings = [96 20 14 00 46 4A 1A 24 1E 03 04 00];
		qcom,mdss-dsi-t-clk-post = <0x04>;
		qcom,mdss-dsi-t-clk-pre = <0x1E>;
		qcom,mdss-dsi-bl-min-level = <2>;
		qcom,mdss-dsi-bl-max-level = <2047>;
		qcom,mdss-brightness-max-level = <2047>;
		qcom,mdss-dsi-dma-trigger = "trigger_sw";
		qcom,mdss-dsi-mdp-trigger = "none";
		qcom,mdss-dsi-bl-pmic-control-type = "bl_ctrl_dcs";
		qcom,mdss-dsi-reset-sequence = <1 5>, <0 5>, <1 5>;
		qcom,mdss-pan-physical-width-dimension = <65>;
		qcom,mdss-pan-physical-height-dimension = <115>;
		qcom,mdss-dsi-lp11-init;
		qcom,mdss-dsi-init-delay-us = <30000>;
		qcom,mdss-dsi-te-check-enable;
		qcom,mdss-dsi-te-using-te-pin;
		//qcom,ulps-enabled;
		qcom,mdss-dsi-rx-eot-ignore;
		qcom,mdss-dsi-tx-eot-append;
		qcom,esd-check-enabled;
		qcom,mdss-dsi-panel-status-command = [06 01 00 01 05 00 02 0A 08];
		qcom,mdss-dsi-panel-status-command-state = "dsi_hs_mode";
		qcom,mdss-dsi-panel-status-check-mode = "reg_read";
		qcom,mdss-dsi-panel-status-read-length = <1>;
		qcom,mdss-dsi-panel-status-value = <0x9C>;
		qcom,mdss-dsi-pan-enable-dynamic-fps;
		qcom,mdss-dsi-pan-fps-update = "dfps_immediate_porch_mode";
		qcom,mdss-dsi-min-refresh-rate = <50>;
		qcom,mdss-dsi-max-refresh-rate = <60>;
	};
};
