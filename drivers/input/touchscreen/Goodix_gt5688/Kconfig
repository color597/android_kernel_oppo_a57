## drivers/input/touchscreen/Goodix_gt5688/Kconfig
```kconfig
#
# Goodix GT5688 Touchscreen driver
#

config GT5688_TOUCHPANEL_DRIVER
	tristate "Goodix GT5688 touchpanel driver"
	depends on TOUCHSCREEN_GT5688
	default n
	help
	  This is the main file for touchpanel driver for Goodix GT5688
	  touchscreens.

	  Say Y here if you have a Goodix GT5688 touchscreen connected
	  to your system.

	  If unsure, say N.

	  To compile this driver as a module, choose M here: the
	  module will be called GT5688.

config GT5688_TOUCHPANEL_UPDATE
	tristate "Goodix GT5688 touchpanel auto update support"
	depends on GT5688_TOUCHPANEL_DRIVER
	default n
	help
	  This enables support for firmware update for Goodix GT5688
	  touchscreens.

	  Say Y here if you have a Goodix GT5688 touchscreen connected
	  to your system.

	  If unsure, say N.

	  To compile this driver as a module, choose M here: the
	  module will be called GT5688_update.

config GT5688_TOUCHPANEL_DEBUG
	tristate "Goodix GT5688 Tools for debuging"
	depends on GT5688_TOUCHPANEL_DRIVER
	default n
	help
	  This is application debug interface support for Goodix GT5688
	  touchscreens.

	  Say Y here if you want to have a Android app debug interface
	  to your system.

	  If unsure, say N.

	  To compile this driver as a module, choose M here: the
	  module will be called GT5688_tool.
```

## drivers/input/touchscreen/oppo_touchscreen/Goodix/Kconfig
```kconfig
source "drivers/input/touchscreen/oppo_touchscreen/Goodix/Goodix_gt5688/Kconfig"
```

## drivers/input/touchscreen/oppo_touchscreen/Kconfig
```kconfig
config TOUCHPANEL_OPPO
	bool "OPPO tp module"
	help
	  Say Y here if you have touchscreen module.

config TOUCHPANEL_SYNAPTICS
#	default y
	bool "TP Synaptics_IC enable or not for OPPO"
	---help---
	say Y to enable driver for Touchpanel useing Synaptics_IC
	  
config TOUCHPANEL_FOCAL
#	default y
	bool "TP Synaptics_IC enable or not for OPPO"
	---help---
	say Y to enable driver for Touchpanel useing FOCALTECK_IC	  
	  
config TOUCHPANEL_GOODIX
#	default y
	bool "TP Synaptics_IC enable or not for OPPO"
	---help---
	say Y to enable driver for Touchpanel useing GOODIX_IC
	
	
source "drivers/input/touchscreen/oppo_touchscreen/util_interface/Kconfig"

if TOUCHPANEL_SYNAPTICS
source "drivers/input/touchscreen/oppo_touchscreen/Synaptics/Kconfig"
endif

if TOUCHPANEL_GOODIX
source "drivers/input/touchscreen/oppo_touchscreen/Goodix/Kconfig"
endif

if TOUCHPANEL_FOCAL
#source "drivers/input/touchscreen/oppo_touchscreen/Focal/Kconfig"
endif
```

## drivers/input/touchscreen/oppo_touchscreen/Synaptics/Kconfig
```kconfig
source "drivers/input/touchscreen/oppo_touchscreen/Synaptics/S3508/Kconfig"
source "drivers/input/touchscreen/oppo_touchscreen/Synaptics/S1302_virtal_key/Kconfig"
```

## drivers/input/touchscreen/synaptics_oppo/Kconfig
```kconfig
#ifdef VENDOR_EDIT
#Added by Tong.han@Bsp.group.Tp for synaptics_ic driver,2015-01-21 
config SYNAPTICS_OPPO
#	default y
	bool "TP Synaptics_IC enable or not for OPPO"
	---help---
	say Y to enable driver for Touchpanel useing Synaptics_IC
#endif
```

## drivers/misc/ktd_shineled/Kconfig
```kconfig
config KTD2026_SLED
	tristate "KTD2026_SLED breath led Driver"
	default n
	help
	  Say Y here to enable breath led.
```

## drivers/soc/Kconfig
```kconfig
menu "SOC (System On Chip) specific Drivers"

source "drivers/soc/qcom/Kconfig"
source "drivers/soc/ti/Kconfig"
source "drivers/soc/versatile/Kconfig"

source "drivers/soc/oppo/Kconfig"
endmenu
```

## drivers/soc/oppo/oppo_fp_common/Kconfig
```kconfig
# ifdef VENDOR_EDIT 
# ziqing.guo add for config oppo fingerprint compatibility
      config OPPO_FP_COMMON
      bool "config oppo fingerprint compatibility"
	  help
		define this config to compile oppo_fp_common.c for device register
#endif /* VENDOR_EDIT */
```
